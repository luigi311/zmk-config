## config/boards/shields/snap/Kconfig.shield
```kconfig
# Copyright (c) 2022 The ZMK Contributors
# SPDX-License-Identifier: MIT

config SHIELD_SNAP_CENTRAL_DONGLE
    def_bool $(shields_list_contains,snap_central_dongle)

config SHIELD_SNAP_CENTRAL_LEFT
    def_bool $(shields_list_contains,snap_central_left)

config SHIELD_SNAP_PERIPHERAL_LEFT
    def_bool $(shields_list_contains,snap_peripheral_left)

config SHIELD_SNAP_PERIPHERAL_RIGHT
    def_bool $(shields_list_contains,snap_peripheral_right)
```

## config/west.yml
```yaml
manifest:
  remotes:
    - name: zmkfirmware
      url-base: https://github.com/luigi311
  projects:
    - name: zmk
      remote: zmkfirmware
      revision: stream_cheap
      import: app/west.yml
  self:
    path: config
```
